-carm
-Z(CODE)CODE,CODE_X,DATA_C=A1560000-FFFFFFFF

-Z(CODE)HOOK_DUMP=A042E614-FFFFFFFF
-Z(CODE)RecordWindow=A05FF118-FFFFFFFF //201C????????0122281C0C30
-Z(CODE)Callinwindow=A02FBC44-FFFFFFFF //FFF73AFC002803D00321201C
-Z(CODE)CallOutWindow=A02FB648-FFFFFFFF //6946????????03226946??-4
-Z(CODE)AddrBookWindow=A0694EAC-FFFFFFFF //0100A0E3000085E50400A0E182DF8DE2
-Z(CODE)AddrBookWindow2=A0694E94-FFFFFFFF //010080E2400BC0E3??????FA
-Z(CODE)PHONEBOOKHOOK=A06999EC-FFFFFFFF //04 10 A0 E106 00 A0 E1????????03 30 A0 E300 20 A0 E3+C

-Z(CODE)SMS_IN_HOOK=A098D718-FFFFFFFF //0298????????3690502811D1B04AB149



-Z(CODE)NUM_SELECT_MENU_HDR_ICON=A095FE44-FFFFFFFF //8B376162656469747669657773F70000+18
-Z(CODE)NUM_SELECT_MENU_LINES=A095FE7C-FFFFFFFF //8B376162656469747669657773F70000+50
-Z(CODE)NUM_SELECT_MENU_ALITEM=A0698288-FFFFFFFF //FA00A0A0E1040096E5-3
-Z(CODE)NUM_SELECT_MENU_TEXT=A069835C-FFFFFFFF //FB81DF8DE2F085BDE8-3
-Z(CODE)NUM_SELECT_MENU_GUI=A0698104-FFFFFFFF //FB0040A0E130139FE5-3


-Z(CODE)EDIAL_CREATE_HOOK=A02F9E78-FFFFFFFF
-Z(CODE)EDIAL_REDRAW_HOOK=A02F9CF0-FFFFFFFF
-Z(CODE)EDIAL_ATTR_HOOK=A02F9E58-FFFFFFFF

-Z(CODE)ADRBKLST_CATWS_HOOK=A068EE50-FFFFFFFF
-Z(CODE)ADRBKLST_CATWS_HOOK2=A068E91C-FFFFFFFF
-Z(CODE)ADRBKLST_CATWS_HOOK3=A068F170-FFFFFFFF
-Z(CODE)ADRBKLST_ALLOCWS_HOOK=A068ED80-FFFFFFFF
-Z(CODE)ADRBKLST_ALLOCWS_HOOK2=A068E8B0-FFFFFFFF
-Z(CODE)ADRBKLST_ALLOCWS_HOOK3=A068F0D4-FFFFFFFF
-Z(CODE)ADRBKLST_LINES_HOOK1=A0961B10-FFFFFFFF
-Z(CODE)ADRBKLST_LINES_HOOK2=A09626CC-FFFFFFFF
-Z(CODE)ADRBKLST_LINES_HOOK3=A0961B40-FFFFFFFF
-Z(CODE)ADRBKLST_SIMALLWS_HOOK=A06AA698-FFFFFFFF
-Z(CODE)ADRBKLST_SIMNUMWS_HOOK=A06AA6EC-FFFFFFFF
