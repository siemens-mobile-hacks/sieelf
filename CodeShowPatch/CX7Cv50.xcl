-carm
-Z(CODE)CODE,DATA_C=A080F550-FFFFFFFF  //OK
-Z(CODE)RecordWindow=A0AFE8EC-FFFFFFFF //OK
-Z(CODE)Callinwindow=A0966ED8-FFFFFFFF //OK
-Z(CODE)CallOutWindow=A09662A6-FFFFFFFF //OK
-Z(CODE)AddrBookWindow=A0AF7AC4-FFFFFFFF //OK
-Z(CODE)AddrBookWindow2=A0AF7AB6-FFFFFFFF //OK
-Z(CODE)PhonebookWindow=A0B4404C-FFFFFFFF //OK
-Z(CODE)SMS_SEND_HOOK=A0A72A74-FFFFFFFF //OK
-Z(CODE)NUM_SELECT_MENU_HOOK=A0B67556-FFFFFFFF //OK
-Z(CODE)NUM_SELECT_MENU_HOOK1=A0B674BE-FFFFFFFF //OK


//-Z(CODE)SMS_IN_HOOK=A092244E-FFFFFFFF //dummy or A0B35682
-Z(CODE)CODE_X=A0810000-FFFFFFFF  //OK
-Z(CODE)READ_SMS_HOOK=0xA0AEA0B4-FFFFFFFF