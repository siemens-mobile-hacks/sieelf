-carm
-Z(CODE)CODE,DATA_C=A01FFA00-FFFFFFFF

//-Z(CODE)HOOK_DUMP=A082B44C-FFFFFFFF
-Z(CODE)RecordWindow=A0554B54-FFFFFFFF
-Z(CODE)Callinwindow=A038F48C-FFFFFFFF
-Z(CODE)CallOutWindow=A038E84A-FFFFFFFF
-Z(CODE)AddrBookWindow=A054DDBC-FFFFFFFF
-Z(CODE)AddrBookWindow2=A054DDAE-FFFFFFFF
-Z(CODE)PhonebookWindow=A057B1EC-FFFFFFFF
