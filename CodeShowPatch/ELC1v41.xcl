-carm
-Z(CODE)CODE,DATA_C=A1360000-FFFFFFFF

-Z(CODE)HOOK_DUMP=A082C53C-FFFFFFFF
-Z(CODE)RecordWindow=A09D1FD2-FFFFFFFF
-Z(CODE)Callinwindow=A0682504-FFFFFFFF
-Z(CODE)CallOutWindow=A0681E3A-FFFFFFFF
-Z(CODE)AddrBookWindow=A0810A7E-FFFFFFFF
-Z(CODE)PHONEBOOKHOOK=A0B5EFF8-FFFFFFFF //00220121281c231c????????211c301c+c
