-carm
-Z(CODE)CODE,DATA_C=A080F6A0-FFFFFFFF  //OK
-Z(CODE)RecordWindow=A0B9A188-FFFFFFFF //
-Z(CODE)Callinwindow=A0974F20-FFFFFFFF //OK
-Z(CODE)CallOutWindow=A09742EE-FFFFFFFF //OK
-Z(CODE)AddrBookWindow=A0B94B00-FFFFFFFF //
-Z(CODE)AddrBookWindow2=A0B94AF2-FFFFFFFF //
-Z(CODE)PhonebookWindow=A0BE39CC-FFFFFFFF //OK
-Z(CODE)SMS_SEND_HOOK=A160FC6C-FFFFFFFF  //OK
-Z(CODE)NUM_SELECT_MENU_HOOK=A0C05F86-FFFFFFFF //OK?
-Z(CODE)NUM_SELECT_MENU_HOOK1=A0C05EEE-FFFFFFFF //OK?

-Z(CODE)SMS_IN_HOOK=0xA092803C-FFFFFFFF  //OK
-Z(CODE)CODE_X=A0810000-FFFFFFFF  //OK
