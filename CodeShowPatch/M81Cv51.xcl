-carm
-Z(CODE)CODE,CODE_X,DATA_C=A1560000-FFFFFFFF

-Z(CODE)HOOK_DUMP=A042E78C-FFFFFFFF
-Z(CODE)RecordWindow=A05FF2AC-FFFFFFFF
-Z(CODE)Callinwindow=A02FBDB8-FFFFFFFF
-Z(CODE)CallOutWindow=A02FB7BC-FFFFFFFF
-Z(CODE)AddrBookWindow=A0695040-FFFFFFFF
-Z(CODE)AddrBookWindow2=A0695028-FFFFFFFF
-Z(CODE)PHONEBOOKHOOK=A0699B80-FFFFFFFF //04 10 A0 E106 00 A0 E1????????03 30 A0 E300 20 A0 E3+C

-Z(CODE)SMS_IN_HOOK=A098E250-FFFFFFFF

-Z(CODE)NUM_SELECT_MENU_HDR_ICON=A096093C-FFFFFFFF
-Z(CODE)NUM_SELECT_MENU_LINES=A0960974-FFFFFFFF
-Z(CODE)NUM_SELECT_MENU_ALITEM=A069841C-FFFFFFFF
-Z(CODE)NUM_SELECT_MENU_TEXT=A06984F0-FFFFFFFF
-Z(CODE)NUM_SELECT_MENU_GUI=A0698298-FFFFFFFF

-Z(CODE)EDIAL_CREATE_HOOK=A02F9FE8-FFFFFFFF
-Z(CODE)EDIAL_REDRAW_HOOK=A02F9E5C-FFFFFFFF
-Z(CODE)EDIAL_ATTR_HOOK=A02F9FC6-FFFFFFFF

-Z(CODE)ADRBKLST_CATWS_HOOK2=A068EAB0-FFFFFFFF
-Z(CODE)ADRBKLST_ALLOCWS_HOOK=A068EF14-FFFFFFFF  //
-Z(CODE)ADRBKLST_CATWS_HOOK=A068EFE4-FFFFFFFF  //
-Z(CODE)ADRBKLST_ALLOCWS_HOOK2=A068EA44-FFFFFFFF
-Z(CODE)ADRBKLST_ALLOCWS_HOOK3=A068F268-FFFFFFFF  //
-Z(CODE)ADRBKLST_CATWS_HOOK3=A068F304-FFFFFFFF  //
-Z(CODE)ADRBKLST_LINES_HOOK1=A0962648-FFFFFFFF
-Z(CODE)ADRBKLST_LINES_HOOK2=A0963204-FFFFFFFF
-Z(CODE)ADRBKLST_LINES_HOOK3=A0962678-FFFFFFFF
-Z(CODE)ADRBKLST_SIMALLWS_HOOK=A06AB108-FFFFFFFF
-Z(CODE)ADRBKLST_SIMNUMWS_HOOK=A06AB15C-FFFFFFFF
