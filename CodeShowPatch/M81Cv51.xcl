-carm
-Z(CODE)CODE,DATA_C=A1560000-FFFFFFFF

-Z(CODE)HOOK_DUMP=A042E78C-FFFFFFFF
-Z(CODE)RecordWindow=A05FF2A6-FFFFFFFF
-Z(CODE)Callinwindow=A02FBDB8-FFFFFFFF
-Z(CODE)CallOutWindow=A02FB7CC-FFFFFFFF
-Z(CODE)AddrBookWindow=A0695034-FFFFFFFF
-Z(CODE)AddrBookWindow2=A0695028-FFFFFFFF
-Z(CODE)PHONEBOOKHOOK=A0699B80-FFFFFFFF //04 10 A0 E106 00 A0 E1????????03 30 A0 E300 20 A0 E3+C
