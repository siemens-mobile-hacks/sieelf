-carm
-Z(CODE)CODE,DATA_C=A01F89A0-FFFFFFFF  //
-Z(CODE)RecordWindow=A0592938-FFFFFFFF //OK
-Z(CODE)Callinwindow=A033D75C-FFFFFFFF //OK
-Z(CODE)CallOutWindow=A033A89C-FFFFFFFF //OK
-Z(CODE)AddrBookWindow=A058BB24-FFFFFFFF //OK
-Z(CODE)AddrBookWindow2=A058BB16-FFFFFFFF //OK
-Z(CODE)PhonebookWindow=A05D2710-FFFFFFFF //OK
-Z(CODE)SMS_SEND_HOOK=A0527BD8-FFFFFFFF  //OK
-Z(CODE)NUM_SELECT_MENU_HOOK=A05E856A-FFFFFFFF //OK
-Z(CODE)NUM_SELECT_MENU_HOOK1=A05E84D2-FFFFFFFF //OK

-Z(CODE)SMS_IN_HOOK=0xA033619C-FFFFFFFF  //OK
-Z(CODE)CODE_X=A01F81F0-FFFFFFFF  //
-Z(CODE)READ_SMS_HOOK=0xA057DE38-FFFFFFFF  //OK