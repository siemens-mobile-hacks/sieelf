-carm
-Z(CODE)CODE,DATA_C=A1560000-FFFFFFFF

-Z(CODE)HOOK_DUMP=A042C65C-FFFFFFFF
-Z(CODE)RecordWindow=A05E7886-FFFFFFFF
-Z(CODE)Callinwindow=A02FD304-FFFFFFFF
-Z(CODE)CallOutWindow=A02FCD18-FFFFFFFF
-Z(CODE)AddrBookWindow=A068A92C-FFFFFFFF
-Z(CODE)AddrBookWindow2=A068A920-FFFFFFFF
-Z(CODE)PHONEBOOKHOOK=A068F478-FFFFFFFF //04 10 A0 E106 00 A0 E1????????03 30 A0 E300 20 A0 E3+C

-Z(CODE)SMS_IN_HOOK=A0996758-FFFFFFFF
-Z(CODE)CODE_X=A1560780-FFFFFFFF

-Z(CODE)NUM_SELECT_MENU_HOOK=A068DCA8-FFFFFFFF
-Z(CODE)NUM_SELECT_MENU_HOOK1=A068DB94-FFFFFFFF

