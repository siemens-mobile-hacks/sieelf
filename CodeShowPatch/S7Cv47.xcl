-carm
-Z(CODE)CODE,DATA_C=A1560000-FFFFFFFF

-Z(CODE)HOOK_DUMP=A042C65C-FFFFFFFF
-Z(CODE)RecordWindow=A05E7886-FFFFFFFF
-Z(CODE)Callinwindow=A02FD304-FFFFFFFF
-Z(CODE)CallOutWindow=A02FCD18-FFFFFFFF
-Z(CODE)AddrBookWindow=A068A92C-FFFFFFFF
-Z(CODE)AddrBookWindow2=A068A920-FFFFFFFF
