-carm
-Z(CODE)CODE,DATA_C=A080F550-FFFFFFFF
-Z(CODE)RecordWindow=A0B9A4FC-FFFFFFFF
-Z(CODE)Callinwindow=A0974F20-FFFFFFFF
-Z(CODE)CallOutWindow=A09742EE-FFFFFFFF
-Z(CODE)AddrBookWindow=A0B94E78-FFFFFFFF
-Z(CODE)AddrBookWindow2=A0B94E6A-FFFFFFFF
-Z(CODE)PhonebookWindow=A0BE3D40-FFFFFFFF
-Z(CODE)SMS_SEND_HOOK=A160F890-FFFFFFFF
-Z(CODE)NUM_SELECT_MENU_HOOK=A0C062FA-FFFFFFFF
-Z(CODE)NUM_SELECT_MENU_HOOK1=A0C06262-FFFFFFFF

-Z(CODE)SMS_IN_HOOK=0xA092803C-FFFFFFFF  //OK
-Z(CODE)CODE_X=A0810000-FFFFFFFF  //OK
-Z(CODE)READ_SMS_HOOK=0xA16270E8-FFFFFFFF