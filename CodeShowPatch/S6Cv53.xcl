-carm

-Z(CODE)JMP_BODY=A0CB1000-FFFFFFFF //S6Cv53地址超出

-Z(CODE)CODE,DATA_C=A0810000-FFFFFFFF  
-Z(CODE)RecordWindow=A0BF071C-FFFFFFFF 
-Z(CODE)Callinwindow=A098FE10-FFFFFFFF 
-Z(CODE)CallOutWindow=A098F1CA-FFFFFFFF 
-Z(CODE)AddrBookWindow=A0BEB094-FFFFFFFF 
-Z(CODE)AddrBookWindow2=A0BEB086-FFFFFFFF 
-Z(CODE)PhonebookWindow=A0C30990-FFFFFFFF 
-Z(CODE)SMS_SEND_HOOK=A1681EB4-FFFFFFFF 

-Z(CODE)NUM_SELECT_MENU_HOOK=A0C54322-FFFFFFFF 
-Z(CODE)NUM_SELECT_MENU_HOOK1=A0C5428A-FFFFFFFF 
