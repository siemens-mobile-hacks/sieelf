-carm
-Z(CODE)CODE,DATA_C=A1560000-FFFFFFFF

-Z(CODE)HOOK_DUMP=A03F4FDC-FFFFFFFF
-Z(CODE)RecordWindow=A050A7F6-FFFFFFFF
-Z(CODE)Callinwindow=A02E9330-FFFFFFFF
-Z(CODE)CallOutWindow=A02E8D44-FFFFFFFF
-Z(CODE)AddrBookWindow=A0575C78-FFFFFFFF //01 00 80 E2 40 0B C0 E3 ???????? 00 40 A0 E1+c
-Z(CODE)AddrBookWindow2=A0575C6C-FFFFFFFF
