-carm
-Z(CODE)CODE,DATA_C=A1560000-FFFFFFFF

-Z(CODE)HOOK_DUMP=A03F4FDC-FFFFFFFF
-Z(CODE)RecordWindow=A050A7F6-FFFFFFFF
-Z(CODE)Callinwindow=A02E9330-FFFFFFFF
-Z(CODE)CallOutWindow=A02E8D44-FFFFFFFF
-Z(CODE)AddrBookWindow=A0575C80-FFFFFFFF

