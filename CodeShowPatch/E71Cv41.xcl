-carm
-Z(CODE)CODE,DATA_C=A1360000-FFFFFFFF

-Z(CODE)HOOK_DUMP=A0838B10-FFFFFFFF
-Z(CODE)RecordWindow=A09CB812-FFFFFFFF
-Z(CODE)Callinwindow=A067E450-FFFFFFFF
-Z(CODE)CallOutWindow=A067DDA2-FFFFFFFF
-Z(CODE)AddrBookWindow=A0805F9E-FFFFFFFF
-Z(CODE)PHONEBOOKHOOK=A0BE2748-FFFFFFFF
//-Z(CODE)AddrBookMenu_HOOK1=A0800E3E-FFFFFFFF
//-Z(CODE)AddrBookMenu_HOOK=A0801034-FFFFFFFF
-Z(CODE)NUM_SELECT_MENU_HOOK=A0808294-FFFFFFFF
-Z(CODE)NUM_SELECT_MENU_HOOK1=A08081E4-FFFFFFFF
