-carm
-Z(CODE)CODE,DATA_C=A1360000-FFFFFFFF

-Z(CODE)RecordWindow=A09CB918-FFFFFFFF		//0E 31 20 1C ???????? 92 49 01 39 20 1C
-Z(CODE)Callinwindow=A067E450-FFFFFFFF		//04E00122????201C????????????????002803D0+C
-Z(CODE)CallOutWindow=A067DD94-FFFFFFFF		//04 22 69 46 01 E0 04 22 ???? 20 1C ???????? 28 78 04 28-8
-Z(CODE)AddrBookWindow=A0805F94-FFFFFFFF	//01 20 28 60 7F B0 02 B0 20 1C F0 BD F8 B5 08 1C-E
-Z(CODE)PHONEBOOKHOOK=A0BE2748-FFFFFFFF		//032200210091019201220221281C231C-8


