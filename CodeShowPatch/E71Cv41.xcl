-carm
-Z(CODE)CODE,DATA_C=A1360000-FFFFFFFF

-Z(CODE)HOOK_DUMP=A082B44C-FFFFFFFF
-Z(CODE)RecordWindow=A09CB812-FFFFFFFF
-Z(CODE)Callinwindow=A067E450-FFFFFFFF
-Z(CODE)CallOutWindow=A067DDA2-FFFFFFFF
-Z(CODE)AddrBookWindow=A0805F9E-FFFFFFFF

