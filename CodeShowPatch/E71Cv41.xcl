-carm
-Z(CODE)CODE,CODE_X,DATA_C=A1360000-FFFFFFFF
-Z(CODE)HOOK_DUMP=A0838B10-FFFFFFFF    //A0C4E7B8 40字节A0C88474
-Z(CODE)HOOK_DUMP2=A0C88474-FFFFFFFF   //A0838B10 44字节
-Z(CODE)RecordWindow=A09CB818-FFFFFFFF
-Z(CODE)Callinwindow=A067E450-FFFFFFFF
-Z(CODE)CallOutWindow=A067DD94-FFFFFFFF
-Z(CODE)AddrBookWindow3=A0805F96-FFFFFFFF
-Z(CODE)AddrBookWindow=A0805F98-FFFFFFFF
-Z(CODE)PHONEBOOKHOOK=A0BE2748-FFFFFFFF

-Z(CODE)SMS_IN_HOOK=A0965114-FFFFFFFF

-Z(CODE)NUM_SELECT_MENU_HDR_ICON=A08D3468-FFFFFFFF
-Z(CODE)NUM_SELECT_MENU_LINES=A08D34A0-FFFFFFFF
-Z(CODE)NUM_SELECT_MENU_ALITEM=A08082D8-FFFFFFFF
-Z(CODE)NUM_SELECT_MENU_TEXT=A0808360-FFFFFFFF
-Z(CODE)NUM_SELECT_MENU_GUI=A08081E0-FFFFFFFF

-Z(CODE)EDIAL_CREATE_HOOK=A067C3E4-FFFFFFFF
-Z(CODE)EDIAL_REDRAW_HOOK=A067C218-FFFFFFFF
-Z(CODE)EDIAL_ATTR_HOOK=A067C3C4-FFFFFFFF


-Z(CODE)ADRBKLST_CATWS_HOOK=A080106C-FFFFFFFF   //dump
-Z(CODE)ADRBKLST_CATWS_HOOK2=A0800C4C-FFFFFFFF  //dump
-Z(CODE)ADRBKLST_CATWS_HOOK3=A08012A4-FFFFFFFF  //dump
-Z(CODE)ADRBKLST_ALLOCWS_HOOK=A0800FD0-FFFFFFFF
-Z(CODE)ADRBKLST_ALLOCWS_HOOK2=A0800C06-FFFFFFFF
-Z(CODE)ADRBKLST_ALLOCWS_HOOK3=A0801236-FFFFFFFF
-Z(CODE)ADRBKLST_LINES_HOOK1=A08D4D88-FFFFFFFF                              
-Z(CODE)ADRBKLST_LINES_HOOK2=A0CE6AFC-FFFFFFFF                               
-Z(CODE)ADRBKLST_LINES_HOOK3=A08D4DB8-FFFFFFFF
-Z(CODE)ADRBKLST_SIMALLWS_HOOK=A0C1AB2C-FFFFFFFF
-Z(CODE)ADRBKLST_SIMNUMWS_HOOK=A0C1AB8C-FFFFFFFF  //dump