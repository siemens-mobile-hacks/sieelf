-carm
-Z(CODE)CODE,DATA_C,CODE_X=A1360000-FFFFFFFF

-Z(CODE)HOOK_DUMP=A0838B10-FFFFFFFF
-Z(CODE)RecordWindow=A09CB818-FFFFFFFF
-Z(CODE)Callinwindow=A067E450-FFFFFFFF
-Z(CODE)CallOutWindow=A067DD94-FFFFFFFF
-Z(CODE)AddrBookWindow3=A0805F96-FFFFFFFF
-Z(CODE)AddrBookWindow=A0805F98-FFFFFFFF
-Z(CODE)PHONEBOOKHOOK=A0BE2748-FFFFFFFF

-Z(CODE)SMS_IN_HOOK=A0965114-FFFFFFFF

-Z(CODE)NUM_SELECT_MENU_HDR_ICON=A08D3468-FFFFFFFF
-Z(CODE)NUM_SELECT_MENU_LINES=A08D34A0-FFFFFFFF
-Z(CODE)NUM_SELECT_MENU_ALITEM=A08082D8-FFFFFFFF
-Z(CODE)NUM_SELECT_MENU_TEXT=A0808360-FFFFFFFF
-Z(CODE)NUM_SELECT_MENU_GUI=A08081E0-FFFFFFFF

-Z(CODE)EDIAL_CREATE_HOOK=A067C3E4-FFFFFFFF
-Z(CODE)EDIAL_REDRAW_HOOK=A067C21A-FFFFFFFF
-Z(CODE)EDIAL_ATTR_HOOK=A067C3C4-FFFFFFFF

//-Z(CODE)AddrBookMenu_HOOK1=A0800E3E-FFFFFFFF
//-Z(CODE)AddrBookMenu_HOOK=A0801034-FFFFFFFF
//-Z(CODE)NUM_SELECT_MENU_HOOK=A0808294-FFFFFFFF
//-Z(CODE)NUM_SELECT_MENU_HOOK1=A08081E4-FFFFFFFF
//-Z(CODE)CODE_X=A1360780-FFFFFFFF
//以上轻松搞定

//以下hook都是比较难移植的一些
//原因是ELKA通讯录部分代码是THUMB模式的，而NEWSGOLD则是ARM模式的，所以以前的搜索移植已经不再凑效。
//但是我又不会armdebugger，只能用IDA慢慢找。又不想大量反汇编。
//把这些hook分三组。

//第一组A068438C开始反汇编,一直反汇编到A0684C4C
//很快发现了       (1)  A068C494 <=> E71 A0800D48
//反到A06846D0发现 (2)  A06846D0 <=> E71 A080113C 

//A068487C 1D 4B 0C FA   BLX     sub_A09974F8  +1 = 0xA09974F9 就是AllocWS
//A068488C BL lib 0x89 GetLangMesIntoWS  留意了
//一直反汇编到A0684CAC第一组的可以说已经解决了。
//剩下的你去反汇编E71的。先导入lib到idb文件里面。。。

//第二组，A095A0D0: 0200000008000000505568A0  A0685550在第一组后面不远处。

//第三组，麻烦如果找不到(1)(2)那样的特征码就只能从PhoneBookHook开始A068F478

//总之就是用IDA这个补丁很难移植。还是如果懂点armdebugger就方便了。

//-Z(CODE)ADRBKLST_ALLOCWS_HOOK=A068485C-FFFFFFFF
//-Z(CODE)ADRBKLST_CATWS_HOOK=A068492C-FFFFFFFF
//-Z(CODE)ADRBKLST_ALLOCWS_HOOK2=A068438C-FFFFFFFF  
//-Z(CODE)ADRBKLST_CATWS_HOOK2=A06843F8-FFFFFFFF
//-Z(CODE)ADRBKLST_ALLOCWS_HOOK3=A0684BB0-FFFFFFFF
//-Z(CODE)ADRBKLST_CATWS_HOOK3=A0684C4C-FFFFFFFF

//-Z(CODE)ADRBKLST_LINES_HOOK1=A095A0D0-FFFFFFFF
//-Z(CODE)ADRBKLST_LINES_HOOK2=A095AC8C-FFFFFFFF
//-Z(CODE)ADRBKLST_LINES_HOOK3=A095A100-FFFFFFFF

//-Z(CODE)ADRBKLST_SIMALLWS_HOOK=A06A00A8-FFFFFFFF
//-Z(CODE)ADRBKLST_SIMNUMWS_HOOK=A06A00FC-FFFFFFFF


