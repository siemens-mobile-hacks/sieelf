-carm
-Z(CODE)CODE,DATA_C=A1560000-FFFFFFFF

-Z(CODE)HOOK_DUMP=A043C240-FFFFFFFF
-Z(CODE)RecordWindow=A05EA3EE-FFFFFFFF //????????0D21201C????????0122281C0C30
-Z(CODE)Callinwindow=A02FAC04-FFFFFFFF //??22??A1??1C??????????????????28??D0??21??1C+a
-Z(CODE)CallOutWindow=A02FA60A-FFFFFFFF //??22??A1??1C??????????78??28??D1
-Z(CODE)AddrBookWindow=A068AC4C-FFFFFFFF //0040A0E104108DE2????????0100A0E3000085E5
-Z(CODE)AddrBookWindow2=A068AC38-FFFFFFFF
-Z(CODE)PHONEBOOKHOOK=A068F790-FFFFFFFF //04 10 A0 E106 00 A0 E1????????03 30 A0 E300 20 A0 E3+C
