-carm
//MySMSYS replace the OpenWave sms system

-Z(CODE)CODE,DATA_C,MY_SMS_SYS_PBODY=A1562600-FFFFFFFF

-Z(CODE)AB_UPDATE_HOOK=A0806AD4-FFFFFFFF

-Z(CODE)COUNT_IN_HOOK=A07CE394-FFFFFFFF //
-Z(CODE)OTHER_COUNT_HOOK=A07CDD18-FFFFFFFF //

-Z(CODE)NEW_IN_WIN_HOOK=A0684750-FFFFFFFF //已测试

-Z(CODE)INBOX_VIEW_HOOK=A051AF8C-FFFFFFFF // 
-Z(CODE)INBOX_OPVIEW_HOOK=A051B464-FFFFFFFF //
-Z(CODE)INBOX_OTH_HOOK=A05F0978-FFFFFFFF //
-Z(CODE)INBOX_REC_HOOK=A05EF100-FFFFFFFF //00 7A 16 28 4F D1 1A A0

-Z(CODE)NMENU_INBOX_HOOK=A07CD8D8-FFFFFFFF //已测试
-Z(CODE)NMENU_DRAFT_HOOK=A07CD8E4-FFFFFFFF //已测试
-Z(CODE)NMENU_SENT_HOOK=A07CD8FC-FFFFFFFF //已测试
-Z(CODE)NMENU_NEWSMG_HOOK=A07CD8B4-FFFFFFFF //已测试

-Z(CODE)ADRBK_NUM_SMS_HOOK=A07815A0-FFFFFFFF

-Z(CODE)SHORTCUT_NEWMSG_HOOK=A07071A8-FFFFFFFF //?
-Z(CODE)SHORTCUT_DRAFT_HOOK=A0707258-FFFFFFFF //?
-Z(CODE)SMS_SENT_HOOK=A07073BC-FFFFFFFF //
-Z(CODE)SMS_INBOX_HOOK=A07071CC-FFFFFFFF //?


-Z(CODE)ORG_SEND_HOOK=A05FD138-FFFFFFFF //已测试

-Z(CODE)REC_SENDSMS_HOOK=A09CAF94-FFFFFFFF //

-Z(CODE)DIAL_SMS_HOOK=A067B2A0-FFFFFFFF //29A0211C
/*
已完成:
极速菜单信息菜单中,统计短信条数将把保存为文件的信息也算进去.
直接替换新信息弹出窗口.
极速菜单中,收件箱,已发送,草稿,新建短信,替换.
通话记录中发送短信,替换.

重要记事,任务,便笺,使用文字格式发送,替

多功能收件箱中,短信查看,回复,引用,转发均替换.



未完成:
多功能收件夹中直接查看--死机 A051AFA2



更新通讯录时,发送更新通讯录数据IPC,(目前还不支持通讯录删除后更新).



通讯录中发送短信,替换.
快捷方式,收件箱,已发送,草稿,新建短信,替换.

*/