-carm
//MySMSYS replace the OpenWave sms system

-Z(CODE)CODE,DATA_C,MY_SMS_SYS_PBODY=A1562600-FFFFFFFF

-Z(CODE)AB_UPDATE_HOOK=A068BB44-FFFFFFFF
-Z(CODE)COUNT_IN_HOOK=A064955C-FFFFFFFF
-Z(CODE)OTHER_COUNT_HOOK=A0648EE0-FFFFFFFF

-Z(CODE)NEW_IN_WIN_HOOK=A03029EC-FFFFFFFF

-Z(CODE)INBOX_VIEW_HOOK=A0508024-FFFFFFFF
-Z(CODE)INBOX_OPVIEW_HOOK=A0508480-FFFFFFFF
-Z(CODE)INBOX_OTH_HOOK=A05275FC-FFFFFFFF

-Z(CODE)NMENU_INBOX_HOOK=A0648AA0-FFFFFFFF
-Z(CODE)NMENU_DRAFT_HOOK=A0648AAC-FFFFFFFF
-Z(CODE)NMENU_SENT_HOOK=A0648AC4-FFFFFFFF
-Z(CODE)NMENU_NEWSMG_HOOK=A0648A7C-FFFFFFFF

-Z(CODE)ADRBK_NUM_SMS_HOOK=A063A150-FFFFFFFF

-Z(CODE)SHORTCUT_NEWMSG_HOOK=A0345B0C-FFFFFFFF
-Z(CODE)SHORTCUT_DRAFT_HOOK=A0345B88-FFFFFFFF
-Z(CODE)SMS_SENT_HOOK=A0345CF0-FFFFFFFF
-Z(CODE)SMS_INBOX_HOOK=A0345B30-FFFFFFFF

-Z(CODE)ORG_SEND_HOOK=A05313D4-FFFFFFFF

-Z(CODE)REC_SENDSMS_HOOK=A05E7020-FFFFFFFF

