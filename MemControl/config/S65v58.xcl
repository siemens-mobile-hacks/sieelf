-carm
-Z(CODE)START,CODE,DATA_C=A005E2A0-FFFFFFFF

-Z(CODE)PATCH_MAINENTER=A12F3220-FFFFFFFF

//browser
-Z(CODE)PATCH_BROWSER_ENTER1=A0ADB234-FFFFFFFF
-Z(CODE)PATCH_BROWSER_ENTER2=A0ADB240-FFFFFFFF //Must be a multiple of 4m! (0, 4, 8, C)
//java
-Z(CODE)PATCH_JAVA_BEARER=A00A12D8-FFFFFFFF

