-carm
-Z(CODE)PATCH_BODY,CODE,DATA_I,DATA_C,DATA_Z,INITTAB=A0CB0D50-FFFFFFFF
-Z(CODE)PATCH_NSGCSMFINDER=A00F231C-FFFFFFFF
-Z(CODE)PATCH_ONKEY_HOOK=A00E3150-FFFFFFFF
-Z(CODE)PATCH_ONMESSAGE_HOOK=A00F2464-FFFFFFFF
