-carm
-Z(CODE)CODE,DATA_C=A1359680-FFFFFFFF
-Z(CODE)RUN_ELF_CODE,RUN_ELF_DATA_C=A1359800-FFFFFFFF
-Z(CODE)SMSHook=A0E4F650-FFFFFFFF
//-Z(CODE)hookwindow=A05D87E4-FFFFFFFF
-Z(CODE)HookShow=A0860BB4-FFFFFFFF
