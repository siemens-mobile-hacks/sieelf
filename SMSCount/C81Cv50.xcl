-carm
-Z(CODE)CODE,DATA_C,RUN_ELF_CODE,RUN_ELF_DATA_C=A155E000-FFFFFFFF  //�հ׵�ַ.ԭʼS7CV47
-Z(CODE)SMS_COUNT_JMP=A10DAD54-FFFFFFFF
-Z(CODE)SMSHook=A0F44B6C-FFFFFFFF
//-Z(CODE)hookwindow=A03048A8-FFFFFFFF
-Z(CODE)HookShow=A045B1FC-FFFFFFFF
-Z(CODE)SMS_FIX_HOOK=A0E22AF8-FFFFFFFF        