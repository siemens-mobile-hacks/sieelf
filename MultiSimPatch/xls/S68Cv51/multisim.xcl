-carm
-Z(CODE)PATCH_BODY=0xA1900000-FFFFFFFF
-Z(CODE)Menu_Hook=0xA0428144-FFFFFFFF
-Z(CODE)Menu_Hook1=0xA0465658-FFFFFFFF
-Z(CODE)csa1=0xA0C2ECD0-FFFFFFFF
-Z(CODE)csa2=0xA0C2F084-FFFFFFFF
-Z(CODE)csa1_1=0xA0C2ECDC-FFFFFFFF
-Z(CODE)csa2_1=0xA0C2F092-FFFFFFFF
-Z(CODE)Msg_dispatch=0xA0BF6994-FFFFFFFF
-Z(CODE)Msg_dispatch_1=0xA0BF69A2-FFFFFFFF
-Z(CODE)SetHTTPProfile=0xA01C48C4-FFFFFFFF
-Z(CODE)SetHTTPProfile_1=0xA01C48D4-FFFFFFFF 
-Z(CODE)GetLgp=0xA08D32BE-FFFFFFFF
-Z(CONST)DATA_I,DATA_ID,INITTAB=0xA1900000-FFFFFFFF
-Z(CONST)DATA_C,DATA_Z=0xA1900000-FFFFFFFF
-Z(CODE)CODE=0xA1900000-FFFFFFFF
